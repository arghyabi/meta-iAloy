## conf/layer.conf
```bitbake
# We have a conf and classes directory, add to BBPATH
BBPATH .= ":${LAYERDIR}"

# We have recipes-* directories, add to BBFILES
BBFILES += "${LAYERDIR}/recipes-*/*/*.bb \
			${LAYERDIR}/recipes-*/*/*.bbappend"

BBFILE_COLLECTIONS += "meta-iAloy"
BBFILE_PATTERN_meta-iAloy = "^${LAYERDIR}/"
BBFILE_PRIORITY_meta-iAloy = "10"

LAYERDEPENDS_meta-iAloy = "core"
LAYERSERIES_COMPAT_meta-iAloy = "warrior"
```
